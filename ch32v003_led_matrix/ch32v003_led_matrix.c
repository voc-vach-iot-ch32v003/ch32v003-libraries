#include "ch32v003_led_matrix.h"
#include <string.h>

// Bảng Font 5x7 chuẩn ASCII (từ mã 32 ' ' đến 126 '~')
static const uint8_t font5x7[][5] = {
    {0x00, 0x00, 0x00, 0x00, 0x00}, // Space (32)
    {0x00, 0x00, 0x5F, 0x00, 0x00}, // !
    {0x00, 0x07, 0x00, 0x07, 0x00}, // "
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    {0x10, 0x08, 0x18, 0x10, 0x08} // ~
};

void ledMatrixInit(LedMatrix_t* dev, uint8_t* buffer, const uint8_t matrixCount, const MCU_Pin_t csPin)
{
    dev->frameBuffer = buffer;
    dev->matrixCount = matrixCount;
    dev->rotation = MATRIX_ROTATE_0;

    max7219Init(&dev->maxDev, csPin, matrixCount);
    ledMatrixClearBuffer(dev);
    ledMatrixUpdate(dev);
}

void ledMatrixClearBuffer(LedMatrix_t* dev)
{
    memset(dev->frameBuffer, 0, dev->matrixCount * 8);
}

void ledMatrixUpdate(LedMatrix_t* dev)
{
    for (uint8_t row = 0; row < 8; row++)
    {
        for (uint8_t devIdx = 0; devIdx < dev->matrixCount; devIdx++)
        {
            const uint8_t rowData = dev->frameBuffer[devIdx * 8 + row];
            max7219WriteReg(&dev->maxDev, devIdx, MAX7219_REG_DIGIT0 + row, rowData);
        }
    }
}

void ledMatrixSetRotation(LedMatrix_t* dev, const MatrixRotation_t rotation)
{
    dev->rotation = rotation;
}

void ledMatrixSetScrollDirection(LedMatrix_t* dev, const MatrixScrollDirection_t direction)
{
    dev->scrollDirection = direction;
}

void ledMatrixDrawPixel(LedMatrix_t* dev, const int16_t x, const int16_t y, const bool state)
{
    const uint16_t totalWidth = dev->matrixCount * 8;
    if (x < 0 || x >= totalWidth || y < 0 || y >= 8) return;

    // Xử lý xoay tọa độ
    int16_t physX = x;
    int16_t physY = y;
    if (dev->rotation == MATRIX_ROTATE_90)
    {
        physX = y;
        physY = totalWidth - 1 - x;
    }
    else if (dev->rotation == MATRIX_ROTATE_180)
    {
        physX = totalWidth - 1 - x;
        physY = 7 - y;
    }
    else if (dev->rotation == MATRIX_ROTATE_270)
    {
        physX = 7 - y;
        physY = x;
    }

    const uint8_t devIdx = physX / 8;
    const uint8_t localX = physX % 8;
    const uint16_t bufferIndex = (devIdx * 8) + physY;

    if (state)
    {
        dev->frameBuffer[bufferIndex] |= (1 << (7 - localX));
    }
    else
    {
        dev->frameBuffer[bufferIndex] &= ~(1 << (7 - localX));
    }
}

void ledMatrixDrawLine(LedMatrix_t* dev, int16_t x0, int16_t y0, const int16_t x1, const int16_t y1, const bool state)
{
    const int16_t dx = (x1 > x0) ? (x1 - x0) : (x0 - x1);
    const int16_t sx = (x0 < x1) ? 1 : -1;
    const int16_t dy = (y1 > y0) ? (y0 - y1) : (y1 - y0);
    const int16_t sy = (y0 < y1) ? 1 : -1;
    int16_t err = dx + dy;

    while (1)
    {
        ledMatrixDrawPixel(dev, x0, y0, state);
        if (x0 == x1 && y0 == y1) break;
        int16_t e2 = 2 * err;
        if (e2 >= dy)
        {
            err += dy;
            x0 += sx;
        }
        if (e2 <= dx)
        {
            err += dx;
            y0 += sy;
        }
    }
}

void ledMatrixDrawChar(LedMatrix_t* dev, const int16_t x, const int16_t y, const char ch, const bool state)
{
    if (ch < 32 || ch > 126) return; // Chỉ xử lý ASCII hiển thị được
    const uint8_t fontIdx = ch - 32;

    for (uint8_t col = 0; col < 5; col++)
    {
        const uint8_t colBits = font5x7[fontIdx][col];
        for (uint8_t row = 0; row < 7; row++)
        {
            if (colBits & (1 << row))
            {
                ledMatrixDrawPixel(dev, x + col, y + row, state);
            }
        }
    }
}

void ledMatrixDrawString(LedMatrix_t* dev, int16_t x, const int16_t y, const char* str, const bool state)
{
    while (*str)
    {
        ledMatrixDrawChar(dev, x, y, *str, state);
        x += 6; // Đội rộng font 5px + 1px khoảng cách
        str++;
    }
}

void ledMatrixScrollTextAnimation(LedMatrix_t* dev, const char* str, const int16_t y, const bool state)
{
    static int16_t currentX = 0;
    static const char* lastStr = NULL;
    const uint16_t totalWidth = dev->matrixCount * 8;
    const int16_t strWidth = strlen(str) * 6;

    // Reset vị trí nếu chuỗi ký tự thay đổi
    if (str != lastStr)
    {
        lastStr = str;
        // Reset vị trí cuộn
        currentX = (dev->scrollDirection == MATRIX_SCROLL_LEFT) ? totalWidth : -strWidth;
    }

    // Xóa bộ đệm và vẽ chuỗi tại vị trí hiện tại
    ledMatrixClearBuffer(dev);
    ledMatrixDrawString(dev, currentX, y, str, state);

    // Thay đổi tọa độ dựa vào hướng chạy cấu hình trong Struct
    if (dev->scrollDirection == MATRIX_SCROLL_LEFT)
    {
        currentX--;
        if (currentX < -strWidth)
        {
            currentX = totalWidth;
        }
    }
    else if (dev->scrollDirection == MATRIX_SCROLL_RIGHT)
    {
        currentX++;
        if (currentX > totalWidth)
        {
            currentX = -strWidth;
        }
    }
}


void ledMatrixSetBrightness(LedMatrix_t* dev, const uint8_t brightness)
{
    max7219SetIntensity(&dev->maxDev, brightness);
}
